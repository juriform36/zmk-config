## config/boards/shields/juriform36/Kconfig.defconfig
```kconfig
# Copyright (c) 2023 The ZMK Contributors
# SPDX-License-Identifier: MIT

if SHIELD_JURIFORM36_LEFT

config ZMK_KEYBOARD_NAME
	default "juriform36"

config ZMK_SPLIT_BLE_ROLE_CENTRAL
	default y

endif

if SHIELD_JURIFORM36_LEFT || SHIELD_JURIFORM36_RIGHT

config ZMK_SPLIT
	default y

endif
```

## config/boards/shields/juriform36/Kconfig.shield
```kconfig
# Copyright (c) 2023 The ZMK Contributors
# SPDX-License-Identifier: MIT

config SHIELD_JURIFORM36_LEFT
    def_bool $(shields_list_contains,juriform36_left)

config SHIELD_JURIFORM36_RIGHT
    def_bool $(shields_list_contains,juriform36_right)
```
